/* i8259.c - Functions to interact with the 8259 interrupt controller
initializing i8259 PIC
enabling and disabling irq, sending EOI
 */

#include "i8259.h"
#include "lib.h"

/* Interrupt masks to determine which interrupts are enabled and disabled */
uint8_t master_mask=0xFF; /* IRQs 0-7  */
uint8_t slave_mask=0xFF;  /* IRQs 8-15 */

#define SLAVE_IRQ_MIN 8  // to subtract ; minimum IRQ # for slave 
#define MAX_IRQ 15 // highest irq number

/* i8259_init
 * description: initializes both the master and slave PIC with the correct control words and masks
 * inputs: none
 * outputs: none
 * side effect: enables slave irq */
void i8259_init(void) {
	// initialize as fully masked
	master_mask = 0xFF;
	slave_mask = 0xFF;

    outb(0xff, MASTER_8259_PORT+1); // mask all master interrupts
    outb(0xff, SLAVE_8259_PORT+1); // mask all slave interrupts
    
    outb(ICW1, MASTER_8259_PORT); // ICW1:  select 8259A-1 init 
    outb(ICW2_MASTER, MASTER_8259_PORT+1);
    outb(ICW3_MASTER, MASTER_8259_PORT+1);
    outb(ICW4, MASTER_8259_PORT+1); // master expects normal EOI

    outb(ICW1, SLAVE_8259_PORT); // ICW1:  select 8259A-1 init 
    outb(ICW2_SLAVE, SLAVE_8259_PORT+1);
    outb(ICW3_SLAVE, SLAVE_8259_PORT+1);  // connected to masters IR2
    outb(ICW4, SLAVE_8259_PORT+1); // master expects normal EOI

    outb (master_mask, MASTER_8259_PORT+1); // restore master IRQ
    outb (slave_mask, SLAVE_8259_PORT+1) ; // restore slave IRQ

	enable_irq(SLAVE_IRQ); // enable slave irq
}

/* enable_irq
 * description: enables the given irq on the master/slave PIC with a new mask
 * inputs: irq_num - num of irq to enable
 * outputs: none
 * side effect: enables a specified irq */
void enable_irq(uint32_t irq_num) {
	if (irq_num < 0 || irq_num > MAX_IRQ) return;
	
	uint32_t i, j;
    uint8_t bitmask = 0xFE; // all masked except for least significant bit
 
    // interrupt generated by master 
	if (irq_num < SLAVE_IRQ_MIN) {
		for (i = 0; i < irq_num; i++) {
			// shift 0 of bitmask to correct position
			bitmask = (bitmask << 1) + 1;
		}
		master_mask &= bitmask;
		outb(master_mask, MASTER_8259_PORT+1); 
	} else { // by slave , update both master and slave data port 
		for (j = SLAVE_IRQ_MIN; j < irq_num; j++) {
			bitmask = (bitmask << 1) + 1;
		}
		slave_mask &= bitmask;
		//outb(master_mask, MASTER_8259_PORT+1); 
		outb(slave_mask, SLAVE_8259_PORT+1); 
	}	   
}

/* disable_irq
 * description: disables the given irq on the master/slave PIC with a new mask
 * inputs: irq_num - num of irq to disable
 * outputs: none
 * side effect: disable a specified irq */
void disable_irq(uint32_t irq_num) {		
	if (irq_num < 0 || irq_num > MAX_IRQ) return;
	
	uint32_t i, j; 
	uint8_t bitmask = 0x01; // none masked except for least significant bit	
	
	// interrupt generated by master 
	if (irq_num < SLAVE_IRQ_MIN) {
		for (i = 0; i < irq_num; i++) {
			// shift 1 of bitmask to correct position
			bitmask = bitmask << 1;
		}
		master_mask |= bitmask;
		outb(master_mask, MASTER_8259_PORT+1); 
	} else { // by slave , update both master and slave data port 
		for (j = SLAVE_IRQ_MIN; j < irq_num; j++) {
			bitmask = bitmask << 1;
		}	
		slave_mask |= bitmask;
	
		if (!slave_mask) master_mask |= (ICW3_SLAVE);
		outb(slave_mask, SLAVE_8259_PORT+1); 
		//outb(master_mask, MASTER_8259_PORT+1); 
	}	
}

/* send_eoi
 * description: helper function to complete an interrupt
 * inputs: irq_num - num of irq to send eoi to
 * outputs: none
 * side effect: sends eoi to the specified irq port */
void send_eoi(uint32_t irq_num) {	
	if (irq_num < 0 || irq_num > MAX_IRQ) return;
	
    if (irq_num < SLAVE_IRQ_MIN) {
		outb(EOI | irq_num , MASTER_8259_PORT);  // sends eoi to master 
	} else { 
		// send eoi to both master and slave 
		outb(EOI | (irq_num - SLAVE_IRQ_MIN), SLAVE_8259_PORT);
		outb(EOI | ICW3_SLAVE , MASTER_8259_PORT);
	}
}
